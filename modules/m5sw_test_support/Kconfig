## modules/m5sw_test_support/Kconfig
```kconfig
menu "M5StopWatch test support"

    config M5SW_TEST_ID
        string "Stable test identifier"
        default "unset"

    config M5SW_CONFIG_ID
        string "Stable test configuration identifier"
        default "unset"

endmenu
```

## modules/m5sw_wifi/Kconfig
```kconfig
menu "M5StopWatch Wi-Fi"

    config M5SW_WIFI_SSID
        string "Controlled test AP SSID"
        default ""
        help
            Keep the default empty in committed sdkconfig.defaults files. Set
            the real value only in a local sdkconfig or through menuconfig.

    config M5SW_WIFI_PASSWORD
        string "Controlled test AP password"
        default ""
        help
            Keep credentials out of version control. An empty value selects
            an open network when an SSID is configured.

    config M5SW_WIFI_TARGET_IPV4
        string "Periodic ICMP target IPv4 address"
        default ""
        help
            Use a fixed host on the controlled LAN. Host names are not resolved
            so the measured traffic does not include DNS activity.

    config M5SW_WIFI_LISTEN_INTERVAL
        int "MAX_MODEM listen interval in beacon periods"
        range 1 10
        default 3

endmenu
```

## tests/full_load/main/Kconfig.projbuild
```kconfig
menu "M5StopWatch Full Load safety"

    config M5SW_FULL_LOAD_SAFETY_ACK
        bool "External Full Load safety limits are approved"
        default n
        help
            Enable only after the power path, fixture, current limit, external
            temperature threshold, and manual stop procedure are recorded and
            approved. The firmware refuses to energize Full Load when disabled.

endmenu
```

## tests/l0_shutdown/sdkconfig.defaults
```kconfig
# ESP-IDF 5.5.5 project defaults for production M5StopWatch hardware.
CONFIG_IDF_TARGET="esp32s3"
CONFIG_ESPTOOLPY_FLASHSIZE_16MB=y
CONFIG_ESPTOOLPY_HEADER_FLASHSIZE_UPDATE=y
CONFIG_SPIRAM=y
CONFIG_SPIRAM_MODE_OCT=y
CONFIG_SPIRAM_SPEED_80M=y
CONFIG_SPIRAM_USE_MALLOC=y
CONFIG_ESP_DEFAULT_CPU_FREQ_MHZ_240=y
CONFIG_COMPILER_WARN_WRITE_STRINGS=y
CONFIG_COMPILER_CXX_EXCEPTIONS=n
CONFIG_COMPILER_CXX_RTTI=n
CONFIG_M5SW_TEST_ID="l0-shutdown"
CONFIG_M5SW_CONFIG_ID="l0-shutdown"
```

## tests/normal_active/sdkconfig.defaults
```kconfig
# ESP-IDF 5.5.5 defaults for the fixed Normal active power test.
CONFIG_IDF_TARGET="esp32s3"
CONFIG_ESPTOOLPY_FLASHSIZE_16MB=y
CONFIG_ESPTOOLPY_HEADER_FLASHSIZE_UPDATE=y
CONFIG_SPIRAM=y
CONFIG_SPIRAM_MODE_OCT=y
CONFIG_SPIRAM_SPEED_80M=y
CONFIG_SPIRAM_USE_MALLOC=y
CONFIG_ESP_DEFAULT_CPU_FREQ_MHZ_240=y
CONFIG_ESP_MAIN_TASK_STACK_SIZE=8192
CONFIG_COMPILER_WARN_WRITE_STRINGS=y
CONFIG_COMPILER_CXX_EXCEPTIONS=n
CONFIG_COMPILER_CXX_RTTI=n
CONFIG_M5SW_TEST_ID="normal-active"
CONFIG_M5SW_CONFIG_ID="normal-active"
```
